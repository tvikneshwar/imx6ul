/*  vikneshwar wakeup pin */

/ {

wakeup_keys:wakeup-keys {
                compatible = "wakeup_keys";
                pinctrl-names = "default";
                pinctrl-0 = <&pinctrl_gpio_wakeup>;
                status = "okay";
               
	        power {
                        label = "Wakeup Button";
                        gpios = <&gpio3 6 GPIO_ACTIVE_HIGH>;
                        linux,code = <KEY_WAKEUP>;
                        gpio-key,wakeup;
                  };

           };

pinctrl_gpio_wakeup: gpio_wakeupgrp {
                fsl,pins = <
                           MX6UL_PAD_LCD_DATA01__GPIO3_IO06  0x1b0b0
                >;
        };


};

