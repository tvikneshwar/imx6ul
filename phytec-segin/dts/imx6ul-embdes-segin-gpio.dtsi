/* Viknehwar segin gpio custom dti 
*
* * Author: Vikneshwar Thandeswaran <vikneshwart@embdestech.com>
*/

#include "imx6ul.dtsi"

/ {

external_gpio1 {

        pinctrl-name = "default";
        pinctrl-0 = <&pinctrl_gpio1>;
        status = "okay";

        };

pinctrl_gpio1: gpio1 {
        fsl,pins = < 
  		
             /* MX6UL_PAD_CSI_MCLK__GPIO4_IO17    0xb0 */
	     /* MX6UL_PAD_CSI_HSYNC__GPIO4_IO20   0xb0
                MX6UL_PAD_CSI_VSYNC__GPIO4_IO19   0xb0 */
             /* MX6UL_PAD_CSI_HSYNC__GPIO4_IO20   0xb0 */ 
   /* 
               MX6UL_PAD_CSI_DATA00__GPIO4_IO21    0xb0                    
                MX6UL_PAD_CSI_DATA01__GPIO4_IO22    0xb0
                MX6UL_PAD_CSI_DATA02__GPIO4_IO23    0xb0
		MX6UL_PAD_CSI_DATA04__GPIO4_IO25    0xb0
                MX6UL_PAD_CSI_DATA05__GPIO4_IO26    0xb0
                MX6UL_PAD_CSI_DATA06__GPIO4_IO27    0xb0
                MX6UL_PAD_CSI_DATA07__GPIO4_IO28    0xb0
  */              
                 
 	/*	MX6UL_PAD_LCD_DATA01__GPIO3_IO06    0xb0 */

		MX6UL_PAD_LCD_DATA02__GPIO3_IO07    0xb0 
		MX6UL_PAD_LCD_DATA03__GPIO3_IO08    0xb0
		MX6UL_PAD_LCD_DATA04__GPIO3_IO09    0xb0
		MX6UL_PAD_LCD_DATA08__GPIO3_IO13    0xb0
		MX6UL_PAD_LCD_DATA09__GPIO3_IO14    0xb0	
		MX6UL_PAD_LCD_DATA10__GPIO3_IO15    0xb0
		MX6UL_PAD_LCD_DATA11__GPIO3_IO16    0xb0 
		MX6UL_PAD_LCD_DATA12__GPIO3_IO17    0xb0
		MX6UL_PAD_LCD_DATA13__GPIO3_IO18    0xb0
		MX6UL_PAD_LCD_DATA14__GPIO3_IO19    0xb0
                
		>;
 };

};



