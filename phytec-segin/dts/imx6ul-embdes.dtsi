/* vikneshwar embdes custom gpio  device tree include */
/* v1.0*/

#include "imx6ul.dtsi"


{

embdes_gpio{
	compatible = "fsl,gpio";
	pinctrl-names = "default";
	pinctrl-0 = <&pinctrl_embdes_gpio>;
	status = "okay";

};





pinctrl_embdes_gpio: embdes_gpios{
	fsl,pins = <
	MX6UL_PAD_LCD_DATA01__GPIO3_IO06    0xb0
	>;
};





};

















